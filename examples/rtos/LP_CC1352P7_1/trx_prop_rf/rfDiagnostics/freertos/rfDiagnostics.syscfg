/*
 * Copyright (c) 2022, Texas Instruments Incorporated
 * All rights reserved.
 *
 * Redistribution and use in source and binary forms, with or without
 * modification, are permitted provided that the following conditions
 * are met:
 *
 * *  Redistributions of source code must retain the above copyright
 *    notice, this list of conditions and the following disclaimer.
 *
 * *  Redistributions in binary form must reproduce the above copyright
 *    notice, this list of conditions and the following disclaimer in the
 *    documentation and/or other materials provided with the distribution.
 *
 * *  Neither the name of Texas Instruments Incorporated nor the names of
 *    its contributors may be used to endorse or promote products derived
 *    from this software without specific prior written permission.
 *
 * THIS SOFTWARE IS PROVIDED BY THE COPYRIGHT HOLDERS AND CONTRIBUTORS "AS IS"
 * AND ANY EXPRESS OR IMPLIED WARRANTIES, INCLUDING, BUT NOT LIMITED TO,
 * THE IMPLIED WARRANTIES OF MERCHANTABILITY AND FITNESS FOR A PARTICULAR
 * PURPOSE ARE DISCLAIMED. IN NO EVENT SHALL THE COPYRIGHT OWNER OR
 * CONTRIBUTORS BE LIABLE FOR ANY DIRECT, INDIRECT, INCIDENTAL, SPECIAL,
 * EXEMPLARY, OR CONSEQUENTIAL DAMAGES (INCLUDING, BUT NOT LIMITED TO,
 * PROCUREMENT OF SUBSTITUTE GOODS OR SERVICES; LOSS OF USE, DATA, OR PROFITS;
 * OR BUSINESS INTERRUPTION) HOWEVER CAUSED AND ON ANY THEORY OF LIABILITY,
 * WHETHER IN CONTRACT, STRICT LIABILITY, OR TORT (INCLUDING NEGLIGENCE OR
 * OTHERWISE) ARISING IN ANY WAY OUT OF THE USE OF THIS SOFTWARE,
 * EVEN IF ADVISED OF THE POSSIBILITY OF SUCH DAMAGE.
 */
// @cliArgs --board /ti/boards/LP_CC1352P7_1 --rtos freertos

/*
 *  rfDiagnostics.syscfg
 */


/* ======== Kernel Configuration ======== */
system.getScript("kernel_config_release.syscfg.js");

/* ======== RF ======== */
var RF = scripting.addModule("/ti/drivers/RF");

/* if an antenna component exists, assign it to the rf instance */
if (system.deviceData.board && system.deviceData.board.components.RF) {
    RF.$hardware = system.deviceData.board.components.RF;
}

/* ======== Pull in SPI and GPIO settings ======== */
const gpio_and_spi_settings = system.getScript("/ti/trx/host/gpio_spi_settings.syscfg.js");

/* ======== LED ======== */
const LED = scripting.addModule("/ti/drivers/GPIO");
const LED_G = LED.addInstance();

/* if a green LED component exists, assign it to the LED_G instance */
if (system.deviceData.board && system.deviceData.board.components.LED_GREEN) {
    LED_G.$hardware = system.deviceData.board.components.LED_GREEN;
}
else
{
    LED_G.mode = "Output";   // Set the LED pin to output
}

LED_G.$name = "CONFIG_GPIO_GLED"; // Descriptive name for the LED_G GPIO

const LED_R = LED.addInstance();

/* if a red LED component exists, assign it to the LED_R instance */
if (system.deviceData.board && system.deviceData.board.components.LED_RED) {
    LED_R.$hardware = system.deviceData.board.components.LED_RED;
}
else
{
    LED_R.mode = "Output";   // Set the LED pin to output
}

LED_R.$name = "CONFIG_GPIO_RLED"; // Descriptive name for the LED_R GPIO

/* ======== USB UART ======== */
var UART2 = scripting.addModule("/ti/drivers/UART2");  // Add a UART2 module
var UART2_USB = UART2.addInstance();                      // Add a UART module instance

/* if a XDS110UART component exists, assign it to the UART_USB instance */
if (system.deviceData.board && system.deviceData.board.components.XDS110UART) {
    UART2_USB.$hardware = system.deviceData.board.components.XDS110UART;
}

UART2_USB.txPinInstance.$name = "CONFIG_PIN_UART_TX";  // Descriptive name for UART TX PIN
UART2_USB.rxPinInstance.$name = "CONFIG_PIN_UART_RX";  // Descriptive name for UART RX PIN
UART2_USB.$name = "CONFIG_UART_0";
UART2_USB.txRingBufferSize = 2048; // TX ring buffer size
UART2_USB.uart.txPin.$assignAllowConflicts = "boosterpack.4";
UART2_USB.uart.rxPin.$assignAllowConflicts = "boosterpack.3";
scripting.suppress("Resource conflict.*", UART2_USB.uart, "txPin");
scripting.suppress("Resource conflict.*", UART2_USB.uart, "rxPin");

/* ======== Pull in Radio and Device Configuration ======== */
const propRfConfig = system.getScript("/ti/prop_rf/rfDiagnosticsPropRf.syscfg.js");

/* Enable Bootloader Backdoor if needed */
const CCFG = scripting.addModule("/ti/devices/CCFG");
CCFG.enableBootloaderBackdoor = false; /* Set to true to enable */
CCFG.dioBootloaderBackdoor    = 15;    /* DIO15; set to the wanted backdoor control pin */

/* ======== SPI    ======== */
const SPI   = scripting.addModule("/ti/drivers/SPI");
const SPI2  = SPI.addInstance();

const regex = /CC26.4|CC13.4|CC26.3/g;
let boardName = system.deviceData.board.source;
boardName = boardName.replace(/.*\//, ""); /* Strip off everything up to and including the last '/' */
boardName = boardName.replace(/\..*/, ""); /* Strip off everything after and including the first '.' */
console.log(boardName)
if(regex.test(boardName))
{
    SPI2.spi.$assign = "SPI0";
}
else
{
    SPI2.spi.$assign = "SSI0";
}

SPI2.$name                             = "CONFIG_SPI_0";
SPI2.mode                              = "Four Pin CS Active Low";
SPI2.defaultTxBufferValue              = "0x00";
SPI2.spi.sclkPin.$assignAllowConflicts = "boosterpack.9";
SPI2.spi.pociPin.$assignAllowConflicts = "boosterpack.3";
SPI2.spi.picoPin.$assignAllowConflicts = "boosterpack.4";
SPI2.spi.csnPin.$assignAllowConflicts   = "boosterpack.10"
scripting.suppress("Connected to hardware.*", SPI2.spi, "sclkPin");
scripting.suppress("Connected to hardware.*", SPI2.spi, "pociPin");
scripting.suppress("Connected to hardware.*", SPI2.spi, "picoPin");
scripting.suppress("Connected to hardware.*", SPI2.spi, "csnPin");
scripting.suppress("Resource conflict.*", SPI2.spi, "pociPin");
scripting.suppress("Resource conflict.*", SPI2.spi, "picoPin");
