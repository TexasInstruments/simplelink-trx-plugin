/*
 * Copyright (c) 2018-2025, Texas Instruments Incorporated
 * All rights reserved.
 *
 * Redistribution and use in source and binary forms, with or without
 * modification, are permitted provided that the following conditions
 * are met:
 *
 * *  Redistributions of source code must retain the above copyright
 *    notice, this list of conditions and the following disclaimer.
 *
 * *  Redistributions in binary form must reproduce the above copyright
 *    notice, this list of conditions and the following disclaimer in the
 *    documentation and/or other materials provided with the distribution.
 *
 * *  Neither the name of Texas Instruments Incorporated nor the names of
 *    its contributors may be used to endorse or promote products derived
 *    from this software without specific prior written permission.
 *
 * THIS SOFTWARE IS PROVIDED BY THE COPYRIGHT HOLDERS AND CONTRIBUTORS "AS IS"
 * AND ANY EXPRESS OR IMPLIED WARRANTIES, INCLUDING, BUT NOT LIMITED TO,
 * THE IMPLIED WARRANTIES OF MERCHANTABILITY AND FITNESS FOR A PARTICULAR
 * PURPOSE ARE DISCLAIMED. IN NO EVENT SHALL THE COPYRIGHT OWNER OR
 * CONTRIBUTORS BE LIABLE FOR ANY DIRECT, INDIRECT, INCIDENTAL, SPECIAL,
 * EXEMPLARY, OR CONSEQUENTIAL DAMAGES (INCLUDING, BUT NOT LIMITED TO,
 * PROCUREMENT OF SUBSTITUTE GOODS OR SERVICES; LOSS OF USE, DATA, OR PROFITS;
 * OR BUSINESS INTERRUPTION) HOWEVER CAUSED AND ON ANY THEORY OF LIABILITY,
 * WHETHER IN CONTRACT, STRICT LIABILITY, OR TORT (INCLUDING NEGLIGENCE OR
 * OTHERWISE) ARISING IN ANY WAY OUT OF THE USE OF THIS SOFTWARE,
 * EVEN IF ADVISED OF THE POSSIBILITY OF SUCH DAMAGE.
 */
// @cliArgs --board /ti/boards/LP_CC1312R7 --rtos freertos

/* ======== Kernel Configuration ======== */
system.getScript("kernel_config_release.syscfg.js");

/* ======== Board ======== */
var board = system.deviceData.board.name;

/* ======== Display ======== */
var Display = scripting.addModule("/ti/display/Display");
var display = Display.addInstance();
display.$hardware = system.deviceData.board.components.XDS110UART;

/* ======== GPIO ======== */
var GPIO = scripting.addModule("/ti/drivers/GPIO");

var gpio0 = GPIO.addInstance();
gpio0.$hardware = system.deviceData.board.components.LED0;
gpio0.$name = "CONFIG_GPIO_LED_RED";

var gpio1 = GPIO.addInstance();
gpio1.$hardware = system.deviceData.board.components.LED1;
gpio1.$name = "CONFIG_GPIO_LED_GREEN";

var gpio2 = GPIO.addInstance();
gpio2.mode  = "Output";
gpio2.$name = "CONFIG_GPIO_SSBL_TRIGGER";
gpio2.gpioPin.$assignAllowConflicts = "boosterpack.18";
scripting.suppress("Resource conflict,@@@.+?@@@ is also in use by @@@.+?@@@,@@@.+?@@@", gpio2, "gpioPin");

var gpio3 = GPIO.addInstance();
gpio3.mode  = "Output";
gpio3.$name = "CONFIG_GPIO_SSBL_RESET";
gpio3.gpioPin.$assign = "boosterpack.36";

/* ======== SPI ======== */
var SPI = scripting.addModule("/ti/drivers/SPI");

var spi0 = SPI.addInstance();
spi0.$name = "CONFIG_SPI_SSBL_HOST";
spi0.mode = "Four Pin CS Active Low";

if (board.match(/CC13|CC26/)) {
    spi0.$hardware = system.deviceData.board.components.LP_SPI;
    spi0.defaultTxBufferValue = "0x00";
}

spi0.spi.csnPin.$assignAllowConflicts = "boosterpack.18";
scripting.suppress("Resource conflict,@@@.+?@@@ is also in use by @@@.+?@@@", spi0.spi, "csnPin");

/* ======== Timer ======== */
var Timer = scripting.addModule("/ti/drivers/Timer");
var timer = Timer.addInstance();
timer.timerType = "32 Bits";
timer.$name = "CONFIG_TIMER_0";
